## config/boards/shields/aokb/Kconfig.shield
```kconfig
# Copyright (c) 2020 Pete Johanson
# SPDX-License-Identifier: MIT

config SHIELD_AOKB_LEFT
	def_bool $(shields_list_contains,aokb_left)

config SHIELD_AOKB_RIGHT
	def_bool $(shields_list_contains,aokb_right)
```

## config/west.yml
```yaml
manifest:
  remotes:
    - name: zmkfirmware
      url-base: https://github.com/zmkfirmware
    - name: llmerlos
      url-base: https://github.com/llmerlos
  projects:
    - name: zmk
      remote: zmkfirmware 
      revision: main
      import: app/west.yml
  self:
    path: config
```
